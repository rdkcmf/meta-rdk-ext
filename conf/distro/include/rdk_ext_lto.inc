## conf/distro/include/rdk_ext_lto.inc
```bitbake
LTO_pn-yajl = ""
LTO_pn-jansson = ""
LTO_pn-log4c = ""
LTO_pn-orc = ""
LTO_pn-nopoll = ""
LTO_pn-ucresolv = ""
LTO_pn-libwebp = ""
LTO_pn-curl-netflix = ""
LTO_pn-cjson = ""
LTO_pn-ipv6calc = ""
LTO_pn-gstreamer1.0 = ""
LTO_pn-gstreamer1.0-plugins-base = ""
LTO_pn-gstreamer1.0-plugins-bad = ""
LTO_pn-gstreamer1.0-plugins-good = ""
LTO_pn-glib-openssl = ""
LTO_pn-graphite2 = ""
LTO_pn-libinput = ""
LTO_pn-nghttp2 = ""
LTO_pn-parodus = ""
LTO_pn-wpeframework = ""
LTO_pn-wpe-webkit = ""
LTO_pn-benchmark = ""
LTO_pn-webcfg = ""
LTO_pn-libtinyxml2 = ""
LTO_pn-qtwebsockets = ""
LTO_pn-libseccomp = ""
```

## conf/layer.conf
```bitbake
BBPATH .= ":${LAYERDIR}"

BBFILES += "\
            ${LAYERDIR}/recipes-*/*/*.bb \
            ${@bb.utils.contains('DISTRO_FEATURES', 'gstreamer1_18',' ${LAYERDIR}/recipes-*/*/*/*.bb ${LAYERDIR}/recipes-*/*/*/*.bbappend ','',d)} \
            ${LAYERDIR}/recipes-*/*/*.bbappend \
           "

BBFILE_COLLECTIONS += "rdk-ext"
BBFILE_PATTERN_rdk-ext := "^${LAYERDIR}/"
BBFILE_PRIORITY_rdk-ext = "6"

LAYERSERIES_COMPAT_rdk-ext = "zeus dunfell"

LAYERDEPENDS_rdk-ext = "multimedia-layer"

require conf/distro/include/rdk_ext_lto.inc
require conf/include/rdk-bbmasks-ext.inc

BBMASK .= "${@bb.utils.contains('DISTRO_FEATURES', 'gstreamer1_18', '', "|meta-rdk-ext/recipes-devtools/orc/orc_0.4.31.bb", d)}"
BBMASK .= "${@bb.utils.contains('DISTRO_FEATURES', 'gstreamer1_18', '', "|meta-rdk-ext/recipes-multimedia/gstreamer/gstreamer1.0_1.14.1.bb", d)}"
BBMASK .= "${@bb.utils.contains('DISTRO_FEATURES', 'gstreamer1_18', '', "|meta-rdk-ext/recipes-multimedia/gstreamer/gstreamer1.0_1.14.1.bbappend", d)}"
BBMASK .= "${@bb.utils.contains('DISTRO_FEATURES', 'gstreamer1_18', '', "|meta-rdk-ext/recipes-multimedia/gstreamer/gstreamer1.0-plugins-base_1.14.1.bb", d)}"
BBMASK .= "${@bb.utils.contains('DISTRO_FEATURES', 'gstreamer1_18', '', "|meta-rdk-ext/recipes-multimedia/gstreamer/gstreamer1.0-plugins-good_1.14.1.bb", d)}"
BBMASK .= "${@bb.utils.contains('DISTRO_FEATURES', 'gstreamer1_18', '', "|meta-rdk-ext/recipes-multimedia/gstreamer/gstreamer1.0-plugins-bad_1.14.1.bb", d)}"
BBMASK .= "${@bb.utils.contains('DISTRO_FEATURES', 'gstreamer1_18', '', "|meta-rdk-ext/recipes-multimedia/gstreamer/gstreamer1.0-omx_1.14.1.bb", d)}"
BBMASK .= "${@bb.utils.contains('DISTRO_FEATURES', 'gstreamer1_18', '', "|meta-rdk-ext/recipes-multimedia/gstreamer/gstreamer1.0-libav_1.14.1.bb", d)}"

BBMASK .= "${@bb.utils.contains('DISTRO_FEATURES', 'wpe-2.28', '', '|meta-rdk-ext/recipes-extended/wpe-webkit/wpe-webkit_2.28.*', d)}"
```
